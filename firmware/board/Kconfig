## firmware/board/Kconfig
```kconfig
menu "Hardware Drivers Config"

config SOC_STM32F411CE
    bool
    select SOC_SERIES_STM32F4
    select RT_USING_COMPONENTS_INIT
    select RT_USING_USER_MAIN
    default y

menu "Onboard Peripheral Drivers"
    menuconfig Board_USING_LizCubic
    bool "USE LizCubic"
        default n
    if Board_USING_LizCubic
        config BSP_USING_USER_DMA_CONFIG
            bool "use user dma config"
            default y
    endif
    
    menuconfig Board_USING_EXT_FLASH
    bool "USE OnBoard FLASH"
        default n
    if Board_USING_EXT_FLASH
        config BSP_USING_QSPI_FLASH
            bool "enable OSPI FLASH(W25Q64)"
        config BSP_USING_SPI_FLASH
            bool "enable SPI FLASH(W25Q64)"
            default n
            select BSP_USING_SPI
            select RT_USING_SFUD
            select RT_SFUD_USING_SPI
    endif
    config BSP_USING_LVGL
        bool "Enable LVGL for LCD"
        select PKG_USING_LVGL
        select BSP_USING_SPI_LCD
        default n

endmenu

menu "On-chip Peripheral Drivers"

    config BSP_USING_GPIO
        bool "Enable GPIO"
        select RT_USING_PIN
        default y

    menuconfig BSP_USING_UART
        bool "Enable UART"
        default y
        select RT_USING_SERIAL
        if BSP_USING_UART
            config BSP_USING_UART1
                bool "Enable UART1"
                default y
            config BSP_UART1_RX_USING_DMA
                bool "Enable UART1 RX DMA"
                depends on BSP_USING_UART1 && RT_SERIAL_USING_DMA
                default n

            config BSP_UART1_TX_USING_DMA
                bool "Enable UART1 TX DMA"
                depends on BSP_USING_UART1 && RT_SERIAL_USING_DMA
                default n
            config BSP_USING_UART2
                bool "Enable UART2"
                default y
            config BSP_UART2_RX_USING_DMA
                bool "Enable UART2 RX DMA"
                depends on BSP_USING_UART2 && RT_SERIAL_USING_DMA
                default n

            config BSP_UART2_TX_USING_DMA
                bool "Enable UART2 TX DMA"
                depends on BSP_USING_UART2 && RT_SERIAL_USING_DMA
                default n
        endif

    menuconfig BSP_USING_I2C1
        bool "Enable I2C1 BUS (software simulation)"
        default n
        select RT_USING_I2C
        select RT_USING_I2C_BITOPS
        select RT_USING_PIN
        if BSP_USING_I2C1
            comment "Notice: PB3 --> 19; PB4 --> 20" 
            config BSP_I2C1_SCL_PIN
                int "i2c1 scl pin number"
                range 0 48
                default 19
            config BSP_I2C1_SDA_PIN
                int "i2c1 sda pin number"
                range 0 48
                default 20
        endif
        
    menuconfig BSP_USING_I2C2
        bool "Enable I2C2 BUS (software simulation)"
        default n
        select RT_USING_I2C
        select RT_USING_I2C_BITOPS
        select RT_USING_PIN
        if BSP_USING_I2C2
            comment "Notice: PA8 --> 8; PA11 --> 11" 
            config BSP_I2C2_SCL_PIN
                int "i2c2 scl pin number"
                range 0 48
                default 8
            config BSP_I2C2_SDA_PIN
                int "i2c2 sda pin number"
                range 0 48
                default 11
        endif
        
    menuconfig BSP_USING_SPI
        bool "Enable SPI BUS"
        default n
        select RT_USING_SPI
        if BSP_USING_SPI
            config BSP_USING_SPI1
                bool "Enable SPI1 BUS"
                default n

            config BSP_SPI1_TX_USING_DMA
                bool "Enable SPI1 TX DMA"
                depends on BSP_USING_SPI1
                default n
                
            config BSP_SPI1_RX_USING_DMA
                bool "Enable SPI1 RX DMA"
                depends on BSP_USING_SPI1
                select BSP_SPI1_TX_USING_DMA
                default n
                
            config BSP_USING_SPI4
                bool "Enable SPI4 BUS"
                default n

            config BSP_SPI4_TX_USING_DMA
                bool "Enable SPI4 TX DMA"
                depends on BSP_USING_SPI4
                default n
                
            config BSP_SPI4_RX_USING_DMA
                bool "Enable SPI4 RX DMA"
                depends on BSP_USING_SPI4
                select BSP_SPI4_TX_USING_DMA
                default n
        endif

  menuconfig BSP_USING_ONCHIP_RTC
        bool "Enable RTC"
        select RT_USING_RTC
        default n
        if BSP_USING_ONCHIP_RTC
            choice
                prompt "Select clock source"
                    default BSP_RTC_USING_LSE

                config BSP_RTC_USING_LSE
                    bool "RTC USING LSE"

                config BSP_RTC_USING_LSI
                    bool "RTC USING LSI"
            endchoice
        endif

    menuconfig BSP_USING_PWM
        bool "Enable pwm"
        default n
        select RT_USING_PWM
        if BSP_USING_PWM
        menuconfig BSP_USING_PWM3
            bool "Enable timer3 output pwm"
            default n
            if BSP_USING_PWM3
                config BSP_USING_PWM3_CH2
                    bool "Enable PWM3 channel2"
                    default n
            endif
        endif

    menuconfig  BSP_USING_WDT
         bool "Enable WDT"
         default n
         select RT_USING_WDT

    source "libraries/HAL_Drivers/Kconfig"
endmenu

menu "Board extended module Drivers"

endmenu

endmenu
```
